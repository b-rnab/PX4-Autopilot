## src/modules/spoofing_detector/Kconfig
```kconfig
menuconfig MODULES_SPOOFING_DETECTOR
	bool "spoofing_detector"
	default n
	---help---
		Enable support for carrier phase and IMU based GNSS spoofing detector.
```
